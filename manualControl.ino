#include <Ps3Controller.h>
#include <ESP32Servo.h>
#include <Wire.h>
#include <SPI.h>
#include <Adafruit_GFX.h>
#include <Adafruit_SSD1306.h>
#include "driver/ledc.h"

#define SCREEN_WIDTH 128
#define SCREEN_HEIGHT 64

#define ENB 23
#define M1_RPWM 12
#define M1_LPWM 13
#define M2_RPWM 4
#define M2_LPWM 14
#define M3_RPWM 27
#define M3_LPWM 5
#define M4_RPWM 19
#define M4_LPWM 18
#define M5_RFKL 2
#define M5_LFKL 15
#define M6_RKPS 33
#define M6_LKPS 32
#define servoPin1 25
#define servoPin2 26

#define M1_RPWM_CH 1
#define M1_LPWM_CH 2
#define M2_RPWM_CH 3
#define M2_LPWM_CH 4
#define M3_RPWM_CH 5
#define M3_LPWM_CH 6
#define M4_RPWM_CH 7
#define M4_LPWM_CH 8
#define M5_RFKL_CH 9
#define M5_LFKL_CH 10
#define M6_RKPS_CH 11
#define M6_LKPS_CH 12

#define MAXV 65535  

Adafruit_SSD1306 display(SCREEN_WIDTH, SCREEN_HEIGHT, &Wire, -1);
Servo servo1, servo2;

int xL=0, yL=0, xR=0, yR=0;
bool T=0,X=0,S=0,C=0;
bool U=0,D=0,L=0,R=0;
bool L1=0,L2=0,L3=0,R1=0,R2=0,R3=0;
bool SELECT=0,START=0;

char *MAC = "a8:42:e3:8d:b5:82";

const unsigned char logo[] PROGMEM = {
  
    0x00, 0x00, 0x00, 0x00, 0x00, 0x00, 0x00, 0x60, 0x00, 0x00, 0x00, 0x00, 0x00, 0x00, 0x00, 0x00, 
    0x00, 0x00, 0x00, 0x00, 0x00, 0x00, 0x00, 0xf0, 0x00, 0x00, 0x00, 0x00, 0x00, 0x00, 0x00, 0x00, 
    0x00, 0x00, 0x00, 0x00, 0x00, 0x00, 0x01, 0xf8, 0x60, 0x00, 0x00, 0x00, 0x00, 0x00, 0x00, 0x00, 
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    0x00, 0x00, 0x00, 0x00, 0x00, 0x00, 0x00, 0x00, 0x00, 0x00, 0x00, 0x00, 0x00, 0x00, 0x00, 0x00
};

uint32_t convertPWM(int value) {
    return (abs(value) * MAXV) / 255;
}

int fast = 255; 
int slow = 90; 

int base = 170; 
int side = 150;
int rot = 110;

int rotate = 0;
int sides = 0;
int speeds = 0;

float offsetX = 1.1;

void setup() {

    Serial.begin(115200);
    
    Ps3.attach(notify);
    Ps3.attachOnConnect(onConnect);
    Ps3.begin(MAC);
    pinMode(ENB, OUTPUT);
    setupLEDC();
    setOled();
    ESP32PWM::allocateTimer(0);
    ESP32PWM::allocateTimer(1);
    ESP32PWM::allocateTimer(2);
    ESP32PWM::allocateTimer(3);
    servo1.setPeriodHertz(50);
    servo2.setPeriodHertz(50);
    servo1.attach(servoPin1, 500, 2400);
    servo2.attach(servoPin2, 500, 2400);
    
    motor(0, 0, 0, 0);
    servo(90, 90);
    fakt(0, 0);
    delay(500);
}

void loop() {
    digitalWrite(ENB, HIGH);

    int motor1 = 0, motor2 = 0, motor3 = 0, motor4 = 0;
    bool offset = (yL == 0 && xR == 0 && xL == 0);

    speeds = (R2 > 0) ? slow : (L2 > 0) ? fast : base;
    sides = (R2 > 0) ? slow : (L2 > 0) ? fast : side;
    rotate = (R2 > 0) ? slow : (L2 > 0) ? fast : rot;

    float x = sqrt((xL * xL) + (yL * yL));
    if (x > 127) { 
        xL = (xL / x) * 127;
        yL = (yL / x) * 127;
    }
    float y = (abs(xL) > 0 && abs(yL) > 0) ? 0.7 : 1.0;
    xL *= y;
    yL *= y;

    if (abs(xL) > abs(yL)) {
        yL = 0;  
    } else if (abs(yL) > abs(xL)) {
        xL = 0;  
    }

    if (!offset) {
        motor1 += speeds * (yL > 0 ? 1 : (yL < 0 ? -1 : 0));
        motor2 += speeds * (yL > 0 ? 1 : (yL < 0 ? -1 : 0));
        motor3 += speeds * (yL > 0 ? 1 : (yL < 0 ? -1 : 0));
        motor4 += speeds * (yL > 0 ? 1 : (yL < 0 ? -1 : 0));

        motor1 += rotate * (xR > 0 ? 1  : (xR < 0 ? -1 : 0));
        motor2 += rotate * (xR > 0 ? -1 : (xR < 0 ? 1  : 0));
        motor3 += rotate * (xR > 0 ? -1 : (xR < 0 ? 1  : 0));
        motor4 += rotate * (xR > 0 ? 1  : (xR < 0 ? -1 : 0));

        motor1 += sides * (xL > 0 ? 1  : (xL < 0 ? -1 : 0));
        motor2 += sides * (xL > 0 ? -1 : (xL < 0 ? 1  : 0));
        motor3 += sides * (xL > 0 ? 1  : (xL < 0 ? -1 : 0));
        motor4 += sides * (xL > 0 ? -1 : (xL < 0 ? 1  : 0));
    } else {
        motor1 = 0;
        motor2 = 0;
        motor3 = 0;
        motor4 = 0;
    }

    if (R1 > 0) {
        fakt(120, 0);
    } else if (L1 > 0) {
        fakt(-120, 0);
    } else if (X > 0) {
        fakt(0, 255);
    } else { 
        fakt(0, 0);
    }

    if (S > 0) {
        servo(107, 75);
    } else if (START > 0) {
        servo(120, 60);
    } else {
        servo(96, 85);
    }

    motor(motor1, motor2, motor3, motor4);
}